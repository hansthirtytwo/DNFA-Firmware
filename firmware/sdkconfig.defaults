## firmware/sdkconfig.defaults
```kconfig
CONFIG_BT_ENABLED=y

CONFIG_BT_BLUEDROID_ENABLED=n
CONFIG_BT_NIMBLE_ENABLED=y

CONFIG_BT_CONTROLLER_ENABLED=y
CONFIG_BT_NIMBLE_TRANSPORT_INTERNAL=y
CONFIG_BT_NIMBLE_HCI_UART_TASK_STACK_SIZE=4096
```
